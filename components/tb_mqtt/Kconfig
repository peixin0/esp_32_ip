## components/tb_mqtt/Kconfig
```kconfig
menu "ThingsBoard MQTT Client Configuration"
    config MQTT_BROKER_URI
        string "MQTT Broker URI"
        default "mqtt://mqtt.eu.thingsboard.cloud:1883"
        help 
            URI (Uniform Resource Identifier) of the MQTT broker to connect to 

    config TB_ACCESS_TOKEN
        string "ThingsBoard Access Token"
        default "YOUR_ACCESS_TOKEN"
        help 
            Access Token for ThingsBoard device authentication

endmenu
        
```

## components/wifi/Kconfig
```kconfig
menu "WiFi STA Configuration"
    config WIFI_STA_SSID
        string "WIFI SSID"
        default "myhotspot"
        help 
            Network Name of the access point to join
    
    config WIFI_STA_PASSWORD
        string "WIFI Password"
        default "change me"
        help 
            Network Password of the access point 
        

endmenu
```
